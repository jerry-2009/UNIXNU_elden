## configs/elden-ufs_rootcheck_defconfig
```kconfig
# Full read-only block interface for post-entry validation, not an asserted root boot.
CONFIG_XNU_BUILD_ARCHIVES=y
CONFIG_XNU_SOURCE_CORECRYPTO14=y
CONFIG_XNU_ARM_DT_PLATFORM=y
CONFIG_XNU_ARMCPU=y
CONFIG_XNU_NATIVE_ARCH_TIMER=y
CONFIG_XNU_NATIVE_PAN=y
CONFIG_XNU_NATIVE_CS_HASH_CACHE=y
CONFIG_XNU_TRUST_CACHE_RUNTIME=y
CONFIG_XNU_BOOT_PROGRESS=n
CONFIG_XNU_NATIVE_UFS=y
CONFIG_XNU_NATIVE_MOBILE_DISPLAY=n
CONFIG_XNU_NATIVE_ADRENO=n
CONFIG_XNU_ARMVIRT_PLATFORM=n
CONFIG_XNU_EXTRA_LD_ARCHIVES=""
CONFIG_XNU_ELDEN_UFS_ROOTCHECK=y
CONFIG_XNU_ELDEN_UFS_ROOT_PARTITION="ARMADA_BACKUP"
```
