// SPDX-License-Identifier: BSD-3-Clause
//
// Lenovo Legion Y700 Gen 4 (TB322FC / elden) hardware description.

/dts-v1/;
/include/ "sm8750.dtsi"

/ {
	model = "Lenovo Legion Y700 Gen 4";
	compatible = "lenovo,elden", "qcom,sm8750";

	// The initial XNU handoff uses 256 MiB of the UEFI DXE heap. The live
	// 12 GiB elden FDT places the Android initrd at B74AC000-B7FFEE30, so the
	// former A8000000 "Kernel" carveout is not safe for a RAM-boot payload.
	// C2400000 starts after the source-described ramoops region and remains
	// below the hwfence reservation at D4E23000.
	memory@c2400000 {
		device_type = "memory";
		reg = <0x0 0xc2400000 0x0 0x10000000>;
	};
};

// UFS: the host controller and PHY are enabled here, but the supplies, reset
// GPIO and clock resources stay in comments until their provider nodes (PMIC
// regulators, TLMM, GCC, RPMh, TCSR, SMMU, ICE) exist in this source. The
// Linux reference for this exact device is
// arch/arm64/boot/dts/qcom/sm8750-lenovo-elden.dts (kernel repo pinned at
// bf96c3d4048973298ede78487177c6f1b4f6bc0f, nodes at lines 2389-2404):
//
//   &ufs_mem_phy { vdda-phy-supply = <&vreg_l1j_0p91>;
//                  vdda-pll-supply = <&vreg_l3g_1p2>; };
//   &ufs_mem_hc  { reset-gpios = <&tlmm 215 GPIO_ACTIVE_LOW>;
//                  vcc-supply = <&vreg_l17b_2p5>; vcc-max-microamp = <1300000>;
//                  vccq-supply = <&vreg_l1d_1p2>; vccq-max-microamp = <1200000>; };
//
// The phase 3 read-only probe deliberately depends on none of that: it uses
// the phase 2.5 RAM-boot path and assumes ABL already left the controller and
// PHY running when it loaded this image.
&ufs_mem_hc {
	status = "okay";
};

&ufs_mem_phy {
	status = "okay";
};
